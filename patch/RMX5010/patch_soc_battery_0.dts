/dts-v1/;
/plugin/;

/ {
	fragment@0 {
		target = <&oplus_chg_comm>;
		__overlay__ {
			oplus_spec,fv-mv = <0x119e 0x119e 0x119e 0x119e 0x119e 0x119e 0x1185 0x1022 0x1022>;
			oplus_spec,sw-fv-mv = <0x116c 0x116c 0x116c 0x116c 0x116c 0x116c 0x1153 0xff0 0xff0>;
			oplus_spec,sw-over-fv-mv = <0x11a8 0x11a8 0x11a8 0x11a8 0x11a8 0x11a8 0x118f 0x102c 0x102c>;
			oplus_spec,vbat_uv_thr_mv = <0xbb8>;
			oplus_spec,vbat_charging_uv_thr_mv = <0xb54>;
			oplus,chg_shutdown_max_mv = <0xbb8>;
		};
	};
};
