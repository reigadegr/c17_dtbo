/dts-v1/;
/plugin/;

/ {
	fragment@0 {
		target = <&oplus_chg_wired>;
		__overlay__ {
			oplus_spec,pd-iclmax-ma = <0x640>;
			oplus_spec,qc-iclmax-ma = <0x640>;
			oplus_spec,non-standard-ibatmax-ma = <0x1f4>;
			oplus_spec,led_on-fccmax-ma = <0x00 0x111 0x554 0x6e0 0x6e0 0x6e0 0x6e0 0x1f4 0x00>;
			oplus_spec,fccmax-ma-lv = <0x00 0x111 0x44c 0x44c 0x44c 0x44c 0x44c 0x44c 0x00 0x00 0x111 0x12c 0x12c 0x12c 0x12c 0x12c 0x12c 0x00 0x00 0x111 0x320 0x320 0x320 0x320 0x320 0x320 0x00 0x00 0x111 0x44c 0x44c 0x44c 0x44c 0x44c 0x44c 0x00 0x00 0x111 0x554 0x672 0x672 0x672 0x672 0x672 0x00 0x00 0x111 0x554 0x6e0 0x6e0 0x6e0 0x6e0 0x683 0x00 0x00 0x111 0x554 0x6e0 0x6e0 0x6e0 0x6e0 0x683 0x00>;
			oplus_spec,fccmax-ma-hv = <0x00 0x111 0x221 0x332 0x44c 0x44c 0x44c 0x44c 0x00 0x00 0x111 0x12c 0x12c 0x12c 0x12c 0x12c 0x12c 0x00 0x00 0x111 0x221 0x320 0x320 0x320 0x320 0x320 0x00 0x00 0x111 0x221 0x332 0x44c 0x44c 0x44c 0x44c 0x00 0x00 0x111 0x221 0x332 0x554 0x672 0x672 0x672 0x00 0x00 0x111 0x221 0x332 0x554 0x6e0 0x6e0 0x683 0x00 0x00 0x111 0x221 0x332 0x554 0x6e0 0x6e0 0x683 0x00>;
			oplus_spec,cool_down_pdqc_vol_mv = <0x2328 0x2328 0x2328>;
			oplus_spec,cool_down_pdqc_curr_ma = <0x4b0 0x640 0x640>;
			oplus_spec,cool_down_vooc_curr_ma = <0x4b0 0x5dc 0x7d0 0x9c4 0xbb8 0xbb8>;
			oplus_spec,cool_down_normal_curr_ma = <0x4b0 0x5dc 0x7d0>;
		};
	};
};