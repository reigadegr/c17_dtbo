/dts-v1/;
/plugin/;

/ {
	fragment@0 {
		target = <&oplus_chg_wired>;
		__overlay__ {
			oplus_spec,pd-iclmax-ma = <0xbb8>;
			oplus_spec,qc-iclmax-ma = <0xbb8>;
			oplus_spec,non-standard-ibatmax-ma = <0x384>;
			oplus_spec,input-power-mw = <0x9c4 0x9c4 0x1d4c 0x2710 0x3a98 0x3840 0x3840>;
			oplus_spec,fccmax-ma-lv = <0x00 0xfc 0x44c 0x44c 0x44c 0x44c 0x44c 0x44c 0x00 0x00 0xfc 0x384 0x384 0x384 0x384 0x384 0x384 0x00 0x00 0xfc 0x320 0x320 0x320 0x320 0x320 0x320 0x00 0x00 0xfc 0x44c 0x44c 0x44c 0x44c 0x44c 0x44c 0x00 0x00 0xfc 0x4ee 0x672 0x672 0x672 0x672 0x607 0x00 0x00 0xfc 0x4ee 0x7e4 0x898 0x898 0x898 0x607 0x00 0x00 0xfc 0x4ee 0x7e4 0x898 0x898 0x898 0x607 0x00>;
			oplus_spec,fccmax-ma-hv = <0x00 0xfc 0x1f9 0x2f5 0x44c 0x44c 0x44c 0x44c 0x00 0x00 0xfc 0x384 0x384 0x384 0x384 0x384 0x384 0x00 0x00 0xfc 0x1f9 0x2f5 0x320 0x320 0x320 0x320 0x00 0x00 0xfc 0x1f9 0x2f5 0x44c 0x44c 0x44c 0x44c 0x00 0x00 0xfc 0x1f9 0x2f5 0x4ee 0x672 0x672 0x607 0x00 0x00 0xfc 0x1f9 0x2f5 0x4ee 0x898 0x898 0x607 0x00 0x00 0xfc 0x1f9 0x2f5 0x4ee 0x898 0x898 0x607 0x00>;
			oplus_spec,cool_down_pdqc_vol_mv = <0x2328 0x2328 0x2328>;
			oplus_spec,cool_down_pdqc_curr_ma = <0x640 0x9c4 0xbb8>;
			oplus_spec,cool_down_vooc_curr_ma = <0x4b0 0x5dc 0x7d0 0x9c4 0xbb8 0xbb8>;
			oplus_spec,cool_down_normal_curr_ma = <0x4b0 0x5dc 0x7d0>;
		};
	};
};