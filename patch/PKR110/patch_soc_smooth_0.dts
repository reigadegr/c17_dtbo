/dts-v1/;
/plugin/;

/ {
	fragment@0 {
		target = <&oplus_chg_comm>;
		__overlay__ {
				oplus,reserve_chg_soc = <0x02>;
				oplus,reserve_dis_soc = <0x02>;
				smooth_strategy {
					oplus_spec,reserve_table_centipercent = <0x00 0x14 0x00 0x00 0xc8 0x64 0x15 0x63 0xc8 0x00 0xc8 0x64 0x64 0x64 0xc8 0x00 0xc8 0x64>;
				};

		};
	};
};
