/dts-v1/;
/plugin/;

/ {
	fragment@0 {
		target = <&oplus_chg_comm>;
		__overlay__ {
			smooth_strategy {
				oplus_spec,reserve_table_centipercent = <0x00 0x14 0x00 0x00 0x1c2 0x64 0x15 0x63 0xc8 0x00 0x1c2 0x64 0x64 0x64 0xc8 0x00 0x1c2 0x64>;
			};
		};
	};
};
